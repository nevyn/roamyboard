/*
 * roamyboard as a unibody: one MCU module, one chain, all 24 keymap columns.
 *
 * SPDX-License-Identifier: MIT
 */

#include <roamyboard.dtsi>

&roamyboard_chain {
    columns = <24>;
    anchor = "mcu";
};

/ {
    // Buttons of a pointing module on the chain.
    chain_buttons_listener: chain_buttons_listener {
        compatible = "zmk,input-listener";
        device = <&roamyboard_chain>;
    };
};
