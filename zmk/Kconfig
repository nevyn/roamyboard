## zmk/Kconfig
```kconfig
# SPDX-License-Identifier: MIT

rsource "drivers/kscan/Kconfig"
rsource "drivers/input/Kconfig"

config ROAMYBOARD_STATUS_SCREEN
    bool "roamyboard status screen on the nice!view"
    default y
    depends on ZMK_DISPLAY && ZMK_DISPLAY_STATUS_SCREEN_CUSTOM && SHIELD_NICE_VIEW
    depends on ROAMYBOARD_KSCAN_165_CHAIN
    select LV_USE_CANVAS
    select LV_USE_IMAGE
    select LV_FONT_MONTSERRAT_12
    select LV_FONT_MONTSERRAT_14
    select LV_FONT_MONTSERRAT_16
    select LV_FONT_MONTSERRAT_18
    select LV_FONT_UNSCII_8
    help
      Replaces the nice!view's status widget, which must be off
      (CONFIG_NICE_VIEW_WIDGET_STATUS=n). docs/firmware.md describes the screen.

config ROAMYBOARD_STATUS_SCREEN_ROTATE_180
    bool "Turn the status screen upside down"
    default y if !$(dt_nodelabel_bool_prop,roamyboard_chain,rotated)
    depends on ROAMYBOARD_STATUS_SCREEN
    help
      Rotates every image by 180 degrees on its way to the nice!view. The
      roamyboard mounts the nice!view with its contacts toward the MCU module,
      which shows the unrotated image upside down. A rotated half (the chain
      node's rotated property) turns the nice!view the right way up, so this
      defaults to off there.

config ROAMYBOARD_HOST_NAMES
    bool "Read the Bluetooth hosts' names for the status screen"
    default y
    depends on ZMK_BLE && SETTINGS && (!ZMK_SPLIT || ZMK_SPLIT_ROLE_CENTRAL)
    select BT_GATT_CLIENT
    help
      Reads each host's GAP Device Name once per encrypted connection and keeps
      it per BLE profile in the settings key roamyboard/host/<n>
      (zmk/include/roamyboard/host_name.h has the format).

config ROAMYBOARD_LOCAL_OTA
    bool "Enter OTA mode with a held key on a split peripheral that has no central"
    default y
    depends on ZMK_SPLIT && ZMK_SPLIT_BLE && !ZMK_SPLIT_ROLE_CENTRAL
    help
      While the split peripheral has no connection to the central, holding the
      key at ROAMYBOARD_LOCAL_OTA_POSITION for ROAMYBOARD_LOCAL_OTA_HOLD_MS
      reboots into the bootloader's OTA mode with the OTA view, as &ota_boot
      does. Releasing the key earlier, or the central connecting, cancels it.
      While the halves are connected, the key does nothing special. This lets
      the right half be updated over Bluetooth while the left half is down.

config ROAMYBOARD_LOCAL_OTA_POSITION
    int "Key position of the local OTA key"
    default 16
    range 0 119
    depends on ROAMYBOARD_LOCAL_OTA
    help
      The position that the peripheral raises for the key: row * 24 + keymap
      column, after the shield's matrix transform, whose col-offset of 12
      places the right half in keymap columns 12 to 23. The default 16 is row 0
      (the number row), keymap column 16: the 0 key on the QWERTY layer of
      zmk/config/roamyboard_split.keymap, where OTA sits on the System layer.
      The right half anchors at its terminator module, so keymap column 16 is
      the fifth key module from the terminator module, and the key exists only
      with 5 or more key modules.

config ROAMYBOARD_LOCAL_OTA_HOLD_MS
    int "How long to hold the local OTA key, in milliseconds"
    default 3000
    range 500 30000
    depends on ROAMYBOARD_LOCAL_OTA
    help
      How long the local OTA key must stay pressed, in milliseconds, before the
      peripheral enters OTA mode. Default 3000.

config ROAMYBOARD_LOCAL_OTA_LABEL
    string "Legend of the local OTA key in the status screen's hint"
    default "0"
    depends on ROAMYBOARD_LOCAL_OTA
    help
      The legend that the status screen's hint names the local OTA key by,
      for example "0" in "hold the 0 key 3 s for OTA". Change it with
      ROAMYBOARD_LOCAL_OTA_POSITION.

config ROAMYBOARD_PDA
    bool "Micro PDA on the split peripheral's display"
    default y
    depends on ZMK_SPLIT && ZMK_SPLIT_BLE && SETTINGS && ROAMYBOARD_STATUS_SCREEN
    select BT_GATT_CLIENT if ZMK_SPLIT_ROLE_CENTRAL
    select BT_GATT_AUTO_DISCOVER_CCC if ZMK_SPLIT_ROLE_CENTRAL
    help
      The peripheral's display shows the PDA while the central is connected.
      While PDA mode is on, the central sends its keyboard keys over the split
      data channel to the PDA instead of the host. docs/pda.md describes it.

config ROAMYBOARD_PDA_TYPE_OUT_STEP_MS
    int "Milliseconds between key presses and releases when the PDA types out"
    default 10
    range 1 100
    depends on ROAMYBOARD_PDA && ZMK_SPLIT_ROLE_CENTRAL
    help
      The central types a note out to the host as one press or release per
      step. Raise it if the host drops characters.

DT_COMPAT_ROAMYBOARD_BEHAVIOR_PDA := roamyboard,behavior-pda

config ROAMYBOARD_BEHAVIOR_PDA
    bool
    default $(dt_compat_enabled,$(DT_COMPAT_ROAMYBOARD_BEHAVIOR_PDA))
    depends on ROAMYBOARD_PDA && ZMK_SPLIT_ROLE_CENTRAL

DT_COMPAT_ROAMYBOARD_BEHAVIOR_BOOT_SCREEN := roamyboard,behavior-boot-screen

config ROAMYBOARD_BEHAVIOR_BOOT_SCREEN
    bool
    default $(dt_compat_enabled,$(DT_COMPAT_ROAMYBOARD_BEHAVIOR_BOOT_SCREEN))

config ROAMYBOARD_MIDI
    bool "MIDI to the host over Bluetooth LE MIDI"
    default y
    depends on ZMK_BLE && (!ZMK_SPLIT || ZMK_SPLIT_ROLE_CENTRAL)
    help
      Adds the BLE-MIDI GATT service beside ZMK's HID service, so a host that
      subscribes to it receives the MIDI keys' messages on the active
      Bluetooth profile. docs/midi.md describes it.

DT_COMPAT_ROAMYBOARD_BEHAVIOR_MIDI_KEY := roamyboard,behavior-midi-key
DT_COMPAT_ROAMYBOARD_BEHAVIOR_MIDI_CC := roamyboard,behavior-midi-cc

config ROAMYBOARD_BEHAVIOR_MIDI
    bool
    default $(dt_compat_enabled,$(DT_COMPAT_ROAMYBOARD_BEHAVIOR_MIDI_KEY)) || $(dt_compat_enabled,$(DT_COMPAT_ROAMYBOARD_BEHAVIOR_MIDI_CC))
    depends on ROAMYBOARD_MIDI

config ROAMYBOARD_MIDI_VIEW
    bool "Show the MIDI keys' state on the PDA while a MIDI layer is on"
    default y
    depends on ROAMYBOARD_BEHAVIOR_MIDI && ROAMYBOARD_PDA && ZMK_SPLIT_ROLE_CENTRAL
    help
      While the highest active layer has MIDI keys, the central sends what
      they play (octave, transpose, velocity, channel, held notes) to the
      split peripheral, whose PDA shows it, and holds the split link at
      latency 0. docs/midi.md describes it.

config ROAMYBOARD_LOG
    bool "Logs over Bluetooth to a bonded host"
    default y
    depends on ZMK_BLE
    select LOG
    select LOG_OUTPUT
    select LOG_RUNTIME_FILTERING
    help
      A log backend that keeps the latest records in RAM (the backlog), and
      the roamyboard log service, which streams them to a bonded host such as
      roamy-log. The backend's levels start at info for every source; the
      host raises them per source. docs/logging.md describes it.

config ROAMYBOARD_LOG_RELAY
    bool
    default y
    depends on ROAMYBOARD_LOG && ZMK_SPLIT_BLE && ZMK_SPLIT_ROLE_CENTRAL
    select BT_GATT_CLIENT
    select BT_GATT_AUTO_DISCOVER_CCC
    help
      The split central subscribes to the peripheral's log service and
      relays its records to the host.

config ROAMYBOARD_LOG_BACKLOG_SIZE
    int "Bytes of RAM for the backlog of log records"
    default 8192
    range 1024 65536
    depends on ROAMYBOARD_LOG
    help
      The backlog keeps the latest log records, whether or not a host is
      subscribed, and drops the oldest to make room. Each record takes its
      text, its source name and 8 bytes.

config ROAMYBOARD_LOG_RELAY_SIZE
    int "Bytes of RAM for the right half's records on their way to the host"
    default 2048
    range 512 16384
    depends on ROAMYBOARD_LOG_RELAY

config ROAMYBOARD_LOG_THREAD_STACK_SIZE
    int "Stack size of the log service's work queue"
    default 1536
    depends on ROAMYBOARD_LOG

if ROAMYBOARD_LOG

# ZMK's USB logging sets its own larger buffer and shorter sleep; these apply otherwise.
config LOG_BUFFER_SIZE
    default 2048

config LOG_PROCESS_THREAD_SLEEP_MS
    default 100

config LOG_PROCESS_THREAD_STACK_SIZE
    default 1024

endif
```

## zmk/boards/shields/roamyboard/Kconfig.shield
```kconfig
# SPDX-License-Identifier: MIT

config SHIELD_ROAMYBOARD
    def_bool $(shields_list_contains,roamyboard)
```

## zmk/boards/shields/roamyboard_split/Kconfig.shield
```kconfig
# SPDX-License-Identifier: MIT

config SHIELD_ROAMYBOARD_LEFT
    def_bool $(shields_list_contains,roamyboard_left)

config SHIELD_ROAMYBOARD_RIGHT
    def_bool $(shields_list_contains,roamyboard_right)
```

## zmk/drivers/input/Kconfig
```kconfig
# SPDX-License-Identifier: MIT

DT_COMPAT_AZOTEQ_IQS5XX := azoteq,iqs5xx

config ROAMYBOARD_INPUT_IQS5XX
    bool
    default $(dt_compat_enabled,$(DT_COMPAT_AZOTEQ_IQS5XX))
    depends on INPUT
    select I2C
    select GPIO

if ROAMYBOARD_INPUT_IQS5XX

config ROAMYBOARD_INPUT_IQS5XX_INIT_PRIORITY
    int "Init priority of the IQS5xx trackpad driver"
    default INPUT_INIT_PRIORITY
    help
      POST_KERNEL priority. It must come after the I2C bus and GPIO drivers.

config ROAMYBOARD_INPUT_IQS5XX_THREAD_STACK_SIZE
    int "Stack size of the IQS5xx trackpad driver's work queue thread"
    default 1024

config ROAMYBOARD_INPUT_IQS5XX_THREAD_PRIORITY
    int "Preemptible priority of the IQS5xx trackpad driver's work queue thread"
    default 10
    help
      The thread does all of the driver's I2C transfers. A transfer while
      RDY is low can wait one report interval for the trackpad, so the
      driver does not use the system work queue.

module = ROAMYBOARD_INPUT_IQS5XX
module-str = IQS5xx trackpad driver
source "subsys/logging/Kconfig.template.log_config"

endif
```

## zmk/drivers/kscan/Kconfig
```kconfig
# SPDX-License-Identifier: MIT

DT_COMPAT_ROAMYBOARD_KSCAN_165_CHAIN := roamyboard,kscan-165-chain

config ROAMYBOARD_KSCAN_165_CHAIN
    bool
    default $(dt_compat_enabled,$(DT_COMPAT_ROAMYBOARD_KSCAN_165_CHAIN))
    depends on KSCAN
    select GPIO
    select SPI
    select ZMK_DEBOUNCE

config ROAMYBOARD_KSCAN_165_CHAIN_INIT_PRIORITY
    int "Init priority of the roamyboard 74HC165 chain kscan driver"
    default 90
    depends on ROAMYBOARD_KSCAN_165_CHAIN
    help
      POST_KERNEL priority. It must come after the SPI bus and GPIO drivers.
```

## zmk/dts/bindings/behaviors/roamyboard,behavior-boot-screen.yaml
```yaml
# SPDX-License-Identifier: MIT

description: |
  Shows a bootloader view on the roamyboard status screen, waits until the display
  has received it (at most 1 s), and then reboots into a mode of the nice!nano's
  Adafruit nRF52 bootloader. Without the status screen it reboots at once. It takes
  no parameters and runs on the half whose key triggered it.
  zmk/dts/behaviors/boot_screen.dtsi defines &boot_screen and &ota_boot.

compatible: "roamyboard,behavior-boot-screen"

include: zero_param.yaml

properties:
  mode:
    type: string
    default: "uf2"
    enum:
      - "uf2"
      - "ota"
    description: |
      The bootloader mode to reboot into. "uf2" (the default) is the USB drive that
      takes a UF2 file, like ZMK's &bootloader. "ota" is Bluetooth DFU, which takes a
      DFU zip from Nordic's nRF Device Firmware Update app. docs/firmware.md describes
      both.
```

## zmk/dts/bindings/behaviors/roamyboard,behavior-midi-cc.yaml
```yaml
# SPDX-License-Identifier: MIT

description: |
  A momentary MIDI control change, sent to the host on the active Bluetooth profile over
  BLE-MIDI: controller param1 goes to value param2 when the key goes down, and to 0 when it
  comes up, on the current channel. &midi_cc 64 127 is a sustain pedal. It runs on the
  central. zmk/dts/behaviors/midi.dtsi defines &midi_cc; docs/midi.md describes it.

compatible: "roamyboard,behavior-midi-cc"

include: two_param.yaml
```

## zmk/dts/bindings/behaviors/roamyboard,behavior-midi-key.yaml
```yaml
# SPDX-License-Identifier: MIT

description: |
  A MIDI key with one parameter, sent to the host on the active Bluetooth profile over
  BLE-MIDI. It runs on the central. zmk/dts/behaviors/midi.dtsi defines &midi_note,
  &midi_drum and &midi_ctl; docs/midi.md describes them.

compatible: "roamyboard,behavior-midi-key"

include: one_param.yaml

properties:
  kind:
    type: string
    required: true
    enum:
      - "note"
      - "drum"
      - "ctl"
    description: |
      "note": the parameter is a MIDI note number (60 is middle C), shifted by the octave
      and transpose, played on the current channel while the key is held.
      "drum": the parameter is a MIDI note number, played as it is on channel 10 while the
      key is held.
      "ctl": the parameter is one of the MIDI_* controls of dt-bindings/roamyboard/midi.h,
      applied when the key goes down.
```

## zmk/dts/bindings/behaviors/roamyboard,behavior-midi-note.yaml
```yaml
# SPDX-License-Identifier: MIT

description: |
  Sends a MIDI note on, channel 1, velocity 100, to the host on the active Bluetooth profile
  when the key goes down, and its note off when the key comes up. The parameter is the MIDI
  note number, 0 to 127; 60 is middle C (C4). It runs on the central.
  zmk/dts/behaviors/midi.dtsi defines &midi_note; docs/midi.md describes BLE-MIDI.

compatible: "roamyboard,behavior-midi-note"

include: one_param.yaml
```

## zmk/dts/bindings/behaviors/roamyboard,behavior-pda.yaml
```yaml
# SPDX-License-Identifier: MIT

description: |
  Sends the central's keyboard keys to the micro PDA on the split peripheral's display
  instead of the host, or back to the host if the behavior's mode is already on. It takes
  no parameters and runs on the central. zmk/dts/behaviors/pda.dtsi defines &pda_sel and
  &pda_note; docs/pda.md describes the PDA.

compatible: "roamyboard,behavior-pda"

include: zero_param.yaml

properties:
  mode:
    type: string
    default: "home"
    enum:
      - "home"
      - "note"
    description: |
      "home" (the default) selects the PDA as slot 6, a sixth device beside the five
      Bluetooth profiles. "note" opens the note editor; Escape there returns to the host.
```
