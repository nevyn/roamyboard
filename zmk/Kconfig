## zmk/dts/bindings/input/azoteq,iqs5xx.yaml
```yaml
# SPDX-License-Identifier: MIT

description: |
  Azoteq IQS5xx-B000 trackpad controller (IQS550, IQS572, IQS525) on I2C, such
  as the TPS48-P203-S on the pointing module. The driver is a Zephyr input
  device: it reports INPUT_REL_X and INPUT_REL_Y for one finger moving,
  INPUT_REL_WHEEL and INPUT_REL_HWHEEL for a two-finger scroll, INPUT_BTN_0 for
  a tap (a click) and for press-and-hold (held until the fingers lift, for
  dragging), and INPUT_BTN_1 for a two-finger tap.

  The trackpad may be absent at boot and may appear or disappear at any time.
  The driver probes for it every second while it is absent, configures it when
  it answers or resets, and never fails the boot without it. While ZMK is
  active, the trackpad never enters its low-power modes; while ZMK is idle, it
  enters them after 1 s without a touch, and a touch still produces input.
  docs/firmware.md describes the states and the power policy.

  The node is a child of the I2C bus, with reg = <0x74>, the IQS5xx's address.
  Every report interval must stay well below CONFIG_I2C_NRFX_TRANSFER_TIMEOUT
  (500 ms): a read while RDY is low waits up to one interval for the trackpad,
  and a longer wait fails the transfer. The build checks that each interval is
  at most half that timeout.

compatible: "azoteq,iqs5xx"

include: i2c-device.yaml

properties:
  rdy-gpios:
    type: phandle-array
    required: true
    description: |
      The trackpad's RDY output, high while its communication window is open.
      Flag it GPIO_ACTIVE_HIGH. The driver reads a frame on each rising edge,
      and enables the interrupt only while the trackpad is configured, since
      RDY floats while no trackpad is attached.

  flip-x:
    type: boolean
    description: Inverts the X axis on the trackpad (FLIP_X in XY Config 0).

  flip-y:
    type: boolean
    description: Inverts the Y axis on the trackpad (FLIP_Y in XY Config 0).

  switch-xy:
    type: boolean
    description: |
      Swaps the X and Y axes on the trackpad (SWITCH_XY_AXIS in XY Config 0),
      so that X runs along the Tx electrodes and Y along the Rx electrodes.

  scroll-divisor:
    type: int
    default: 32
    description: |
      Relative counts of a two-finger scroll per wheel step, 1 or more. The
      driver keeps the counts below one step and adds them to the next frame's,
      until the fingers lift. Lower values scroll faster.

  active-report-ms:
    type: int
    default: 10
    description: |
      Report interval in milliseconds of the trackpad's Active and Idle-Touch
      modes, which it runs while a finger is on it. 1 to half of
      CONFIG_I2C_NRFX_TRANSFER_TIMEOUT.

  idle-report-ms:
    type: int
    default: 10
    description: |
      Report interval in milliseconds of the trackpad's Idle mode, in which it
      waits for a touch. While ZMK is active, the trackpad stays in Idle mode
      between touches, so this is the latency of the first touch. 1 to half of
      CONFIG_I2C_NRFX_TRANSFER_TIMEOUT.

  lp1-report-ms:
    type: int
    default: 80
    description: |
      Report interval in milliseconds of the trackpad's LP1 mode, which it
      enters 1 s after the last touch while ZMK is idle. 1 to half of
      CONFIG_I2C_NRFX_TRANSFER_TIMEOUT.

  lp2-report-ms:
    type: int
    default: 160
    description: |
      Report interval in milliseconds of the trackpad's LP2 mode, which follows
      LP1 after the LP1 timeout in the trackpad's own settings. 1 to half of
      CONFIG_I2C_NRFX_TRANSFER_TIMEOUT.
```

## zmk/dts/bindings/kscan/roamyboard,kscan-165-chain.yaml
```yaml
# SPDX-License-Identifier: MIT

description: |
  Key scan for one half of roamyboard: a chain of 74HC165 shift registers, one per
  key module, read over SPI. After a /PL pulse the chain shifts out one byte per key
  module, nearest the MCU module first, input H first. The terminator module feeds
  0xFF, so the first byte with bit 7 set ends the chain. The driver counts the key
  modules on every scan, and reports keys only while that count is stable.
  docs/firmware.md describes the protocol and the column mapping.

  The node is a child of the SPI bus that the chain's CLK (SCK) and DATA (MISO)
  are wired to. It has no chip select; reg is <0>. The SPI mode comes from the
  spi-cpol and spi-cpha properties; leave both out for mode 0, the mode that
  docs/firmware.md explains.

  Reported coordinates: row 0 is the top key of a key module (input rows - 1), the
  last row its bottom key (input A, SW1). Columns are keymap columns within this
  half, 0 to columns - 1; the matrix transform's col-offset places them in the
  keymap.

compatible: "roamyboard,kscan-165-chain"

include: [kscan.yaml, spi-device.yaml]

properties:
  load-gpios:
    type: phandle-array
    required: true
    description: |
      The /PL (SH/LD) line of the chain. Flag it GPIO_ACTIVE_LOW; the driver
      asserts it for 1 us before each read to load the switch states.

  columns:
    type: int
    required: true
    description: |
      Number of keymap columns that this half owns: 30 for a unibody, 15 for each
      half of a split. Key modules that map outside these columns are ignored.

  anchor:
    type: string
    required: true
    enum:
      - "mcu"
      - "terminator"
    description: |
      The end of the half that keymap columns are counted from. "mcu": the key
      module nearest the MCU module is keymap column columns - 1, and the mapping
      does not depend on the key module count. "terminator": the key module
      nearest the terminator module is keymap column 0, so every key module's
      keymap column changes when a key module is added or removed.

  rows:
    type: int
    default: 5
    description: |
      Keys per key module, 1 to 7. Row r reads 74HC165 input number rows - 1 - r,
      counting A as 0: with 5, rows 0 to 4 are SW5 (input E) to SW1 (input A).

  max-key-modules:
    type: int
    default: 32
    description: |
      Longest chain that the driver can read. Each scan reads max-key-modules + 1
      bytes; a chain whose sentinel is not among them is a fault.

  stable-scans:
    type: int
    default: 3
    description: |
      Number of consecutive scans that must observe the same key module count
      before the driver accepts it. Scans run every poll-period-ms while a
      count settles, so the default accepts a count after about 30 ms. While the observed count differs from the
      accepted one, the driver reports no key events. When a new count is
      accepted, the driver first releases every key that it reports pressed.

  debounce-press-ms:
    type: int
    default: 5
    description: Debounce time for key press in milliseconds. Use 0 for eager debouncing.

  debounce-release-ms:
    type: int
    default: 5
    description: Debounce time for key release in milliseconds.

  debounce-scan-period-ms:
    type: int
    default: 1
    description: |
      Time between scans in milliseconds while any key is pressed or debouncing.

  poll-period-ms:
    type: int
    default: 10
    description: Time between scans in milliseconds while the chain is idle.
```
